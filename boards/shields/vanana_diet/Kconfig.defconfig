## boards/shields/vanana_diet/Kconfig.defconfig
```kconfig
if SHIELD_VANANA_DIET

# Name must be less than 16 characters long!
config ZMK_KEYBOARD_NAME
    default "Vanana Diet"

config ZMK_POINTING
    default y
    
config SPI
	default y


config ZMK_DISPLAY
	select LV_FONT_MONTSERRAT_28

if ZMK_DISPLAY

config SPI
	default y

config LS0XX
	default y

config ZMK_DISPLAY_INVERT
	default y

endif # ZMK_DISPLAY




endif # SHIELD_VANANA_DIET    
```

## boards/shields/vanana_diet/Kconfig.shield
```kconfig
# No whitespace after the comma or in your keyboard name!

config SHIELD_VANANA_DIET
    def_bool $(shields_list_contains,vanana_diet)
```
